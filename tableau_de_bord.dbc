VERSION ""

NS_ :

BS_:

BU_:

BO_ 200 VehiculeData: 2 ECU
 SG_ VitesseVehicule : 0|8@1+ (1, 0) [0|250] "km/h" ECU
 SG_ NiveauCarburant : 8|8@1+ (1, 0) [0|100] "%" ECU

BO_ 100 MoteurData: 4 ECU
  SG_ MoteurRPM  : 0|16@1+ (0.125,0) [0|7000] "RPM" ECU
  SG_ MoteurTemp : 16|16@1- (1,0) [-10|150] "°C" ECU
